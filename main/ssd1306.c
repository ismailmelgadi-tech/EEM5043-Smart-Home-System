#include "ssd1306.h"
#include "driver/i2c.h"
#include "string.h"
#include "freertos/task.h"

#define SSD1306_SET_MEM_MODE        0x20
#define SSD1306_SET_COL_ADDR        0x21
#define SSD1306_SET_PAGE_ADDR       0x22
#define SSD1306_SET_DISP_START_LINE 0x40
#define SSD1306_SET_CONTRAST        0x81
#define SSD1306_SET_CHARGE_PUMP     0x8D
#define SSD1306_SET_SEG_REMAP       0xA0
#define SSD1306_SET_ENTIRE_ON       0xA4
#define SSD1306_SET_NORM_INV        0xA6
#define SSD1306_SET_MUX_RATIO       0xA8
#define SSD1306_SET_DISP            0xAE
#define SSD1306_SET_COM_OUT_DIR     0xC0
#define SSD1306_SET_DISP_OFFSET     0xD3
#define SSD1306_SET_DISP_CLK_DIV    0xD5
#define SSD1306_SET_PRECHARGE       0xD9
#define SSD1306_SET_COM_PIN_CFG     0xDA
#define SSD1306_SET_VCOM_DESEL      0xDB

static const uint8_t font_5x7[95][5] = {
    {0x00, 0x00, 0x00, 0x00, 0x00}, // space
    {0x00, 0x00, 0x5F, 0x00, 0x00}, // !
    {0x00, 0x07, 0x00, 0x07, 0x00}, // "
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    {0x08, 0x04, 0x08, 0x10, 0x08}, // ~
};

static void ssd1306_write_command(SSD1306_t *dev, uint8_t command) {
    uint8_t buffer[2] = {0x00, command};
    i2c_master_write_to_device(dev->i2c_port, dev->address, 
                              buffer, sizeof(buffer), 
                              1000 / portTICK_PERIOD_MS);
}

static void ssd1306_write_data(SSD1306_t *dev, const uint8_t *data, size_t len) {
    uint8_t *buffer = malloc(len + 1);
    buffer[0] = 0x40;
    memcpy(&buffer[1], data, len);
    i2c_master_write_to_device(dev->i2c_port, dev->address, 
                              buffer, len + 1, 
                              1000 / portTICK_PERIOD_MS);
    free(buffer);
}

void ssd1306_init(SSD1306_t *dev, uint8_t width, uint8_t height) {
    dev->width = width;
    dev->height = height;
    ssd1306_write_command(dev, SSD1306_SET_DISP | 0x00);
    ssd1306_write_command(dev, SSD1306_SET_DISP_CLK_DIV);
    ssd1306_write_command(dev, 0x80);
    ssd1306_write_command(dev, SSD1306_SET_MUX_RATIO);
    ssd1306_write_command(dev, height - 1);
    ssd1306_write_command(dev, SSD1306_SET_DISP_OFFSET);
    ssd1306_write_command(dev, 0x00);
    ssd1306_write_command(dev, SSD1306_SET_DISP_START_LINE | 0x00);
    ssd1306_write_command(dev, SSD1306_SET_CHARGE_PUMP);
    ssd1306_write_command(dev, 0x14);
    ssd1306_write_command(dev, SSD1306_SET_MEM_MODE);
    ssd1306_write_command(dev, 0x00);
    ssd1306_write_command(dev, SSD1306_SET_SEG_REMAP | 0x01);
    ssd1306_write_command(dev, SSD1306_SET_COM_OUT_DIR | 0x08);
    ssd1306_write_command(dev, SSD1306_SET_COM_PIN_CFG);
    ssd1306_write_command(dev, 0x02);
    ssd1306_write_command(dev, SSD1306_SET_CONTRAST);
    ssd1306_write_command(dev, 0x8F);
    ssd1306_write_command(dev, SSD1306_SET_PRECHARGE);
    ssd1306_write_command(dev, 0xF1);
    ssd1306_write_command(dev, SSD1306_SET_VCOM_DESEL);
    ssd1306_write_command(dev, 0x40);
    ssd1306_write_command(dev, SSD1306_SET_ENTIRE_ON);
    ssd1306_write_command(dev, SSD1306_SET_NORM_INV);
    ssd1306_write_command(dev, SSD1306_SET_DISP | 0x01);
    vTaskDelay(100 / portTICK_PERIOD_MS);
}

void ssd1306_clear_screen(SSD1306_t *dev, bool invert) {
    uint8_t zero_buffer[dev->width];
    memset(zero_buffer, invert ? 0xFF : 0x00, dev->width);
    int pages = dev->height / 8;
    for (int page = 0; page < pages; page++) {
        ssd1306_write_command(dev, SSD1306_SET_PAGE_ADDR);
        ssd1306_write_command(dev, page);
        ssd1306_write_command(dev, 0x07);
        ssd1306_write_command(dev, SSD1306_SET_COL_ADDR);
        ssd1306_write_command(dev, 0);
        ssd1306_write_command(dev, dev->width - 1);
        ssd1306_write_data(dev, zero_buffer, dev->width);
    }
}

static void ssd1306_write_char(SSD1306_t *dev, uint8_t x, uint8_t y, char ch, bool invert) {
    if (ch < 32 || ch > 126) return;
    uint8_t char_data[5];
    memcpy(char_data, font_5x7[ch - 32], 5);
    if (invert) {
        for (int i = 0; i < 5; i++) char_data[i] = ~char_data[i];
    }
    ssd1306_write_command(dev, SSD1306_SET_PAGE_ADDR);
    ssd1306_write_command(dev, y);
    ssd1306_write_command(dev, y);
    ssd1306_write_command(dev, SSD1306_SET_COL_ADDR);
    ssd1306_write_command(dev, x);
    ssd1306_write_command(dev, x + 4);
    ssd1306_write_data(dev, char_data, 5);
}

void ssd1306_display_text(SSD1306_t *dev, int page, char *text, int text_len, bool invert) {
    if (page < 0 || page >= (dev->height / 8)) return;
    uint8_t clear_buffer[dev->width];
    memset(clear_buffer, invert ? 0xFF : 0x00, dev->width);
    ssd1306_write_command(dev, SSD1306_SET_PAGE_ADDR);
    ssd1306_write_command(dev, page);
    ssd1306_write_command(dev, page);
    ssd1306_write_command(dev, SSD1306_SET_COL_ADDR);
    ssd1306_write_command(dev, 0);
    ssd1306_write_command(dev, dev->width - 1);
    ssd1306_write_data(dev, clear_buffer, dev->width);
    uint8_t x = 0;
    for (int i = 0; i < text_len && x < dev->width - 5; i++) {
        ssd1306_write_char(dev, x, page, text[i], invert);
        x += 6;
    }
}