## sdkconfig.defaults
```kconfig
# ESP32C3 Basic Configuration
CONFIG_IDF_TARGET="esp32c3"

# Enable RainMaker
CONFIG_ESP_RMAKER_WORK_QUEUE_TASK_STACK=4096

# WiFi Configuration
CONFIG_ESP_WIFI_SOFTAP_SUPPORT=n

# FreeRTOS
CONFIG_FREERTOS_HZ=1000

# Partition Table
CONFIG_PARTITION_TABLE_CUSTOM=y
CONFIG_PARTITION_TABLE_CUSTOM_FILENAME="partitions.csv"
CONFIG_PARTITION_TABLE_FILENAME="partitions.csv"

# BLE (for provisioning if needed later)
CONFIG_BT_ENABLED=y
CONFIG_BT_BLUEDROID_ENABLED=y
CONFIG_BT_NIMBLE_ENABLED=n

# Log levels
CONFIG_LOG_DEFAULT_LEVEL_INFO=y
CONFIG_LOG_MAXIMUM_LEVEL_VERBOSE=y

# ESP System
CONFIG_ESP_SYSTEM_EVENT_TASK_STACK_SIZE=4096

# Flash size
CONFIG_ESPTOOLPY_FLASHSIZE_4MB=y
CONFIG_ESPTOOLPY_FLASHSIZE="4MB"
CONFIG_ESPTOOLPY_FLASHFREQ_80M=y

# Optimization
CONFIG_COMPILER_OPTIMIZATION_SIZE=y
```
